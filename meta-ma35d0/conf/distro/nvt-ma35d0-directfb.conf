## meta-nua3500/conf/machine/nua3500-qt.conf
```bitbake
#@TYPE: Machine
#@NAME: nua3500-evb
#@DESCRIPTION: Configuration for all NUA3500 boards (EV, DK, ...)
#@NEEDED_BSPLAYERS: layers/meta-openembedded/meta-oe layers/meta-openembedded/meta-python

MACHINEOVERRIDES = "nua3500:nua3500qt"

require conf/machine/include/nua3500-base.inc
# =========================================================================
# Kernel
# =========================================================================
KERNEL_DEFCONFIG = "nua3500_defconfig"
KERNEL_DEVICETREE = "nuvoton/nua3500-evb.dtb"

# =========================================================================
# u-boot
# =========================================================================
UBOOT_CONFIG ??= "sdcard spinand nand"
UBOOT_CONFIG[nand] = "nua3500_defconfig"
UBOOT_CONFIG[spinand] = "nua3500_defconfig"
UBOOT_CONFIG[sdcard] = "nua3500_defconfig"

# =========================================================================
# optee-os
# =========================================================================
# Whether Pack image contian OPTEE
#MACHINE_FEATURES_append = " optee "

# =========================================================================
# fs
# =========================================================================
IMAGE_FSTYPES += " ubi " 
# Use the expected value of the ubifs filesystem's volume name in the kernel
UBI_VOLNAME = "rootfs"
# The biggest NANDs on current modules are 256MB.
# This sums up to 2048 LEBs available for the ubifs (-c)
MKUBIFS_ARGS = "-F -m 2048 -e 126976 -c 2048"
UBINIZE_ARGS = "-m 2048 -p 128KiB -s 2048 -O 2048"
```
