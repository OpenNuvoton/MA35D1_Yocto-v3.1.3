## meta-ma35d1/conf/machine/numaker_som_ma35d15ab1a.conf
```bitbake
#@TYPE: Machine
#@NAME: ma35d1-evb
#@DESCRIPTION: Configuration for all ma35d1 boards (EV, DK, ...)
#@NEEDED_BSPLAYERS: layers/meta-openembedded/meta-oe layers/meta-openembedded/meta-python

MACHINEOVERRIDES = "ma35d1:ma35d1som"

require conf/machine/include/ma35d1-base.inc
# =========================================================================
# Kernel
# =========================================================================
KERNEL_SRCREV = "master"
KERNEL_DEFCONFIG = "ma35d1_defconfig"

# Set DDR Size according to the board.
# The currently provideed device tree are as follows:
#       - nuvoton/ma35d1-som-256m.dtb
#       - nuvoton/ma35d1-som-512m.dtb
#       - nuvoton/ma35d1-som-1g.dtb
#       - nuvoton/ma35d1-som-2g.dtb
KERNEL_DEVICETREE = "nuvoton/ma35d1-som-2g.dtb"

# Set linux verison
# The currently provideed linux verison are as follows:
#       - 5.4.181
#       - 5.10.140
PREFERRED_VERSION_linux-ma35d1 = "5.10.140"
# =========================================================================
# u-boot
# =========================================================================
UBOOT_SRCREV = "master"
UBOOT_CONFIG ??= "sdcard nand spinand"
UBOOT_CONFIG[nand] = "ma35d1_nand_defconfig"
UBOOT_CONFIG[spinand] = "ma35d1_spinand_defconfig"
UBOOT_CONFIG[sdcard] = "ma35d1_sdcard0_defconfig"

# =========================================================================
# trusted-firmware-a
# =========================================================================
TFA_SRCREV = "master"

# Set CPU speed and DDR type according to the board.
# The currently provideed device tree are as follows:
#       - ma35d1-cpu1g-wb-256m
#       - ma35d1-cpu1g-wb-512m
#
#       - ma35d1-cpu1g-mc-1gb
#       - ma35d1-cpu1g-custom-ddr
#
#       - ma35d1-cpu800-wb-256m
#       - ma35d1-cpu800-wb-512m
#
#       - ma35d1-cpu800-mc-1gb
#       - ma35d1-cpu800-custom-ddr
TFA_DTB = "ma35d1-cpu800-custom-ddr"

# Update custom DDR parameters when TFA_DTB=ma35d1-cpu800-custom-ddr
TFA_DDR_HEADER = "MA35D15A087C_NonMCP_WBDDR3L_1G_2PCS.h"

# Set DDR_SIZE, it is vaild when TFA_DTB=ma35d1-cpu800-custom-ddr
TFA_DDR_SIZE = "0x80000000"

# Load RTP-M4 into FIP image and run RTP-M4
TFA_LOAD_M4 = "no"

# Need to set binary file from deploy/images/{machine}
TFA_M4_BIN= "m4proj/Template.bin"

# Set PMIC model
#  0: No PMIC
#  1: Dialog
#  2: IP6103
#  3: APW7704F
TFA_PMIC = "1"

# Set CPU core Power
# Suggestion: 1.25 for BGA packages, 1.20V for LQFP packages
# 120: 1.20V, 125: 1.25V, etc.
TFA_CPU_VOLTAGE = "125"
# =========================================================================
# secure boot
# =========================================================================
# "yes" boot from secure mode
# "no" boot from normal mode
SECURE_BOOT = "no"

# The NuWriter will encrypt all relative files by AES, 
# and calculate the ECDSA signature
AES_KEY = "0A0BC81E5AFBF836C5E0CFBEA12C1E269A2EBC3B0B6EC39EEE1C7142F760EBC4"
ECDSA_KEY = "8F1571E9975006A545DF854264F7B18934B5CB2EE619E66DBC0FBEA52C71C919"

# =========================================================================
# optee-os
# =========================================================================
# Whether Pack image contian OPTEE
# MACHINE_FEATURES_append = " optee "
OPTEE_SRCREV = "master"

# =========================================================================
# fs
# =========================================================================
IMAGE_FSTYPES = " sdcard ext4 tar.bz2 ubi spinand nand spinor jffs2"

# =========================================================================
# libjpeg-turbo
# =========================================================================
JPEG_HW_DEC = "yes"

# =========================================================================
# Auto Expand SD Max Size
# =========================================================================
# Change "/dev/mmcblk0" or "p1" as below to match the one use by 
# the SD card in ma35d1 board.
# Need to add CORE_IMAGE_EXTRA_INSTALL += " sd-maxsize" in conf/local.conf to enable.
DISK_DRIVE = "/dev/mmcblk0"
DISK_NUM = "p1"
```

## meta-ma35d1/recipes-bsp/u-boot/files/images.its
```
/dts-v1/;

/ {
	description = "U-Boot fitImage for ma35d1 aarch64 kernel";
	#address-cells = <1>;

	images {
		kernel {
			description = "Linux Kernel";
			data = /incbin/("./Image");
			type = "kernel";
			arch = "arm64";
			os = "linux";
			compression = "none";
			load = <0x80080000>;
			entry = <0x80080000>;
			hash-1 {
				algo = "sha256";
			};
		};
		fdt-1 {
			description = "Flattened Device Tree blob for SPINAND boot";
			data = /incbin/("./ma35d1-evb--5.4.55-r0-ma35d1-qt-20201102142448.dtb");
			type = "flat_dt";
			arch = "arm64";
			compression = "none";
			load = <0x88000000>;
			hash-1 {
				algo = "sha256";
			};
		};
		fdt-2 {
			description = "Flattened Device Tree blob for NAND boot";
                        data = /incbin/("./ma35d1-evb--5.4.55-r0-ma35d1-qt-20201102142448.dtb");
                        type = "flat_dt";
                        arch = "arm64";
                        compression = "none";
                        load = <0x88000000>;
                        hash-1 {
                                algo = "sha256";
                        };
                };
		fdt-3 {
			description = "Flattened Device Tree blob for SDCARD boot";
                        data = /incbin/("./ma35d1-evb--5.4.55-r0-ma35d1-qt-20201102142448.dtb");
                        type = "flat_dt";
                        arch = "arm64";
                        compression = "none";
                        load = <0x88000000>;
                        hash-1 {
                                algo = "sha256";
                        };
                };
	};

	configurations {
		default = "conf-nand";
		conf-spinand {
			description = "SPINAND configuration"; 
			kernel = "kernel";
			fdt = "fdt-1";
		};
		conf-nand {
			description = "NAND configuration";
                        kernel = "kernel";
                        fdt = "fdt-2";
                };
		conf-sdcard {
			description = "SDCARD configuration";
                        kernel = "kernel";
                        fdt = "fdt-3";
                };
	};
};
```

## meta-ma35h0/conf/distro/nvt-ma35h0.conf
```bitbake
# Nuvoton DISTRO for the FrameBuffer graphical backend.

include conf/distro/include/nvt-base.inc

DISTRO = "nvt-ma35h0"

# Remove conflicting backends.
DISTRO_FEATURES_remove = " vc8000 dcultrafb gc520 directfb virtualization "
```

## meta-ma35h0/conf/machine/numaker-hmi-ma35h04f70.conf
```bitbake
#@TYPE: Machine
#@NAME: ma35h0-hmi
#@DESCRIPTION: Configuration for all ma35h0 boards (EV, DK, ...)
#@NEEDED_BSPLAYERS: layers/meta-openembedded/meta-oe layers/meta-openembedded/meta-python

MACHINEOVERRIDES = "ma35h0:ma35h0hmi"

require conf/machine/include/ma35h0-base.inc
# =========================================================================
# Kernel
# =========================================================================
KERNEL_SRCREV = "master"
KERNEL_DEFCONFIG = "ma35h0_defconfig"

# Set DDR Size according to the board.
# The currently provideed device tree are as follows:
# 	- nuvoton/ma35h0-hmi-128m.dtb
KERNEL_DEVICETREE = "nuvoton/ma35h0-hmi-128m.dtb"

# Set linux verison
# The currently provideed linux verison are as follows:
#       - 5.10.140
PREFERRED_VERSION_linux-ma35h0 = "5.10.140"
# =========================================================================
# u-boot
# =========================================================================
UBOOT_SRCREV = "master"
UBOOT_CONFIG ??= "sdcard spinand nand spinor"
UBOOT_CONFIG[nand] = "ma35h0_nand_defconfig"
UBOOT_CONFIG[spinand] = "ma35h0_spinand_defconfig"
UBOOT_CONFIG[sdcard] = "ma35h0_sdcard0_defconfig"
UBOOT_CONFIG[spinor] = "ma35h0_spinor_defconfig"

UBOOT_SPINOR_BOOTARGS= "root=/dev/mmcblk1p1 rootfstype=ext4"

# =========================================================================
# trusted-firmware-a
# =========================================================================
TFA_SRCREV = "master"

# Set CPU speed, DDR type according to the board. 
# The currently provideed device tree are as follows:
TFA_DTB = "ma35h0-cpu650-custom-ddr"

# Update custom DDR parameters
TFA_DDR_HEADER = "MA35H04F764C_MCP_WBDDR2_128M_1PCS.h"

# Set DDR_SIZE
TFA_DDR_SIZE = "0x8000000"

# Load CORE1 into FIP image and run it
TFA_LOAD_CORE1 = "no"

# Need to set binary file from deploy/images/{machine}
TFA_CORE1_BIN = "AMP_Core1RTOS.bin"
#TFA_CORE1_BIN = "AmpCore1.bin"
TFA_CORE1_IPI = "yes"
TFA_CORE1_BASE = "0x88000000"
TFA_CORE1_LEN = "0x200000"

# Set PMIC model
TFA_PMIC = "0"
# =========================================================================
# secure boot
# =========================================================================
# "yes" boot from secure mode
# "no" boot from normal mode
SECURE_BOOT ="no"

# The NuWriter will encrypt all relative files by AES, 
# and calculate the ECDSA signature
AES_KEY = "0A0BC81E5AFBF836C5E0CFBEA12C1E269A2EBC3B0B6EC39EEE1C7142F760EBC4"
ECDSA_KEY = "8F1571E9975006A545DF854264F7B18934B5CB2EE619E66DBC0FBEA52C71C919"

# =========================================================================
# optee-os
# =========================================================================
# Whether Pack image contian OPTEE
#MACHINE_FEATURES_append = " optee "
OPTEE_SRCREV = "master"

# =========================================================================
# fs
# =========================================================================
# The system default is sdhci1 to boot, if you want to use sdhci0 to boot,
# you need to set UBOOT_CONFIG[sdcard] = "ma35h0_sdcard1_defconfig" 
IMAGE_FSTYPES = " sdcard ext4 tar.bz2 ubi spinand nand"

# =========================================================================
# libjpeg-turbo
# =========================================================================
JPEG_HW_DEC = "yes"

# =========================================================================
# Auto Expand SD Max Size
# =========================================================================
# Change "/dev/mmcblk0" or "p1" as below to match the one use by 
# the SD card in ma35h0 board.
# Need to add CORE_IMAGE_EXTRA_INSTALL += " sd-maxsize" in conf/local.conf to enable.
DISK_DRIVE = "/dev/mmcblk0"
DISK_NUM = "p1"
```

## meta-nua3500/conf/distro/include/nvt-base.inc
```bitbake
# NUA3500 DISTRO for the FrameBuffer graphical backend.

DISTRO = "nvt-base"
DISTRO_NAME = "Nuvoton Release Distro"
DISTRO_VERSION = "5.5-dunfell"

DISTRO_CODENAME = "dunfell"
SDK_VENDOR = "-pokysdk"
SDK_VERSION := "${DISTRO_VERSION}"

MAINTAINER = "Nuvoton <www.nuvoton.com>"

TARGET_VENDOR = "-poky"

DISTRO = "nvt-nua3500-fb"


PREFERRED_PROVIDER_udev = "systemd"
PREFERRED_PROVIDER_udev-utils = "systemd"


# =========================================================================
# DISTRO features
# =========================================================================
DISTRO_FEATURES = " dcultrafb gc520 directfb virtualization systemd "
```

## meta-nua3500/conf/distro/nvt-nua3500-directfb.conf
```bitbake
# Nuvoton DISTRO for the FrameBuffer graphical backend.

include conf/distro/include/nvt-base.inc

DISTRO = "nvt-nua3500-directfb"

# Remove conflicting backends.
DISTRO_FEATURES_append += " gc520 "
```

## meta-nua3500/conf/distro/nvt-nua3500-fb.conf
```bitbake
# Nuvoton DISTRO for the FrameBuffer graphical backend.

include conf/distro/include/nvt-base.inc

DISTRO = "nvt-nua3500-fb"

# Remove conflicting backends.
DISTRO_FEATURES_remove = "  dcultrafb gc520 directfb virtualization "
```

## meta-nua3500/conf/layer.conf
```bitbake
# We have a conf and classes directory, add to BBPATH
BBPATH .= ":${LAYERDIR}"

# We have a recipes-* directories, add to BBFILES
BBFILES += "${LAYERDIR}/recipes-*/*/*.bb \
            ${LAYERDIR}/recipes-*/*/*.bbappend"

BBFILE_COLLECTIONS += "nua3500-layer"
BBFILE_PATTERN_nua3500-layer := "^${LAYERDIR}/"
BBFILE_PRIORITY_nua3500-layer = "8"

# This should only be incremented on significant changes that will
# cause compatibility issues with other layers
LAYERVERSION_nua3500-layer = "1"
LAYERSERIES_COMPAT_nua3500-layer = "dunfell"

# for optee-os-nua3500 dependency
LAYERDEPENDS_nua3500-layer = "core openembedded-layer meta-python"
LAYERDEPENDS_nua3500-layer += " qt5-layer "

# docker 
#CORE_IMAGE_EXTRA_INSTALL = "libcgroup cgroup-lite docker net-tools ca-certificates ffmpeg gstreamer1.0 gstreamer1.0-plugins-base"

CORE_IMAGE_EXTRA_INSTALL += " ${@bb.utils.contains('DISTRO_FEATURES', 'directfb', 'directfb', '', d)} "
CORE_IMAGE_EXTRA_INSTALL += " ${@bb.utils.contains('DISTRO_FEATURES', 'gc520', 'gc520', '', d)} "
CORE_IMAGE_EXTRA_INSTALL += " ${@bb.utils.contains('DISTRO_FEATURES', 'dcultrafb', 'dcultrafb', '', d)} "
```

## meta-nua3500/conf/machine/include/nua3500-base.inc
```bitbake
#@TYPE: Machine
#@NAME: nua3500
#@DESCRIPTION: Configuration for all NUA3500 boards (EV, DK, ...)
#@NEEDED_BSPLAYERS: layers/meta-openembedded/meta-oe layers/meta-openembedded/meta-python

MACHINEOVERRIDES = "nua3500"

# =========================================================================
# Chip architecture
# =========================================================================
DEFAULTTUNE_nua3500 = "cortexa35"
include conf/machine/include/tune-cortexa35.inc

# =========================================================================
# Kernel
# =========================================================================
PREFERRED_PROVIDER_kernel = "linux-nua3500"
PREFERRED_PROVIDER_virtual/kernel = "linux-nua3500"

# =========================================================================
# u-boot
# =========================================================================
PREFERRED_PROVIDER_u-boot = "u-boot-nua3500"
PREFERRED_PROVIDER_virtual/bootloader = "u-boot-nua3500"

EXTRA_IMAGEDEPENDS += "virtual/bootloader"

UBOOT_ENTRYPOINT_nua3500 = "0x80E00000"
# =========================================================================
# trusted-firmware-a
# =========================================================================
TFA_PLATFORM = "nua3500"
PREFERRED_PROVIDER_virtual/trusted-firmware-a = "tf-a-nua3500"
EXTRA_IMAGEDEPENDS += "virtual/trusted-firmware-a"

# =========================================================================
# optee-os
# =========================================================================
OPTEE_PLATFORM = "nuvoton"
OPTEE_PLATFORM_FLAVOR = "NUA3500"
PREFERRED_PROVIDER_virtual/optee-os = "optee-os-nua3500"
EXTRA_IMAGEDEPENDS += "virtual/optee-os"

# =========================================================================
# m4proj
# =========================================================================
EXTRA_IMAGEDEPENDS += "m4proj"

# =========================================================================
# nuwriter
# =========================================================================
EXTRA_IMAGEDEPENDS += "python3-nuwriter-native"

# =========================================================================
# fs
# =========================================================================
IMAGE_FSTYPES = " spinand sdcard nand ext2 tar.bz2 "
IMAGE_CLASSES = "image_types_nvt"

# Disable the serial console due to auto-serial-console
SERIAL_CONSOLES = "115200;ttyS0"

# we do not want to have getty running on tty1 as we run
# auto-serial-console there
USE_VT = "0"
```
