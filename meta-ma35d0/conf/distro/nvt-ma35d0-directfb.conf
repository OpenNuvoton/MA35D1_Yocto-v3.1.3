## meta-ma35d1/conf/machine/numaker-iot-ma35d14f884.conf
```bitbake
#@TYPE: Machine
#@NAME: ma35d1-evb
#@DESCRIPTION: Configuration for all ma35d1 boards (EV, DK, ...)
#@NEEDED_BSPLAYERS: layers/meta-openembedded/meta-oe layers/meta-openembedded/meta-python

MACHINEOVERRIDES = "ma35d1:ma35d1iot"

require conf/machine/include/ma35d1-base.inc
# =========================================================================
# Kernel
# =========================================================================
KERNEL_SRCREV = "master"
KERNEL_DEFCONFIG = "ma35d1_defconfig"

# Set DDR Size according to the board.
# The currently provideed device tree are as follows:
# 	- nuvoton/ma35d1-iot-128m.dtb
# 	- nuvoton/ma35d1-iot-256m.dtb
# 	- nuvoton/ma35d1-iot-512m.dtb
KERNEL_DEVICETREE = "nuvoton/ma35d1-iot-256m.dtb"

# Set linux verison
# The currently provideed linux verison are as follows:
#       - 5.4.181
#       - 5.10.140
PREFERRED_VERSION_linux-ma35d1 = "5.10.140"
# =========================================================================
# u-boot
# =========================================================================
UBOOT_SRCREV = "master"
UBOOT_CONFIG ??= "sdcard spinand nand spinor initramfs"
UBOOT_CONFIG[nand] = "ma35d1_nand_defconfig"
UBOOT_CONFIG[spinand] = "ma35d1_spinand_defconfig"
UBOOT_CONFIG[sdcard] = "ma35d1_sdcard1_defconfig"
UBOOT_CONFIG[spinor] = "ma35d1_spinor_defconfig"
UBOOT_CONFIG[initramfs] = "ma35d1_spinand_defconfig"

UBOOT_SPINOR_BOOTARGS= "root=/dev/mmcblk1p1 rootfstype=ext4"

# =========================================================================
# trusted-firmware-a
# =========================================================================
TFA_SRCREV = "master"

# Set CPU speed, DDR type according to the board. 
# The currently provideed device tree are as follows:
#	- ma35d1-cpu800-wb-128m
#	- ma35d1-cpu800-wb-256m
#	- ma35d1-cpu800-wb-512m
#	- ma35d1-cpu800-custom-ddr
TFA_DTB = "ma35d1-cpu800-custom-ddr"

# Update custom DDR parameters when TFA_DTB=ma35d1-cpu800-custom-ddr
TFA_DDR_HEADER = "MA35D16F884_LQFP-216_MCP_WinbondDDR3L_256M_1PCS.h"

# Set DDR_SIZE, it is vaild when TFA_DTB=ma35d1-cpu800-custom-ddr
TFA_DDR_SIZE = "0x20000000"

# Load RTP-SCP into FIP image and run M4 or CORE1
TFA_LOAD_SCP = "no"

# Need to set binary file from deploy/images/{machine}
# yes = M4, no = CORE1
TFA_SCP_M4 = "yes"
TFA_SCP_BIN= "m4proj/Template.bin"
#TFA_SCP_BIN = "AMP_Core1RTOS.bin"
#TFA_SCP_BIN = "AmpCore1.bin"

#These are vaild when TFA_SCP_M4 set to "no"
TFA_SCP_IPI = "yes"
TFA_SCP_BASE = "0x88000000"
TFA_SCP_LEN = "0x200000"

# Set PMIC model
#  0: No PMIC
#  1: Dialog
#  2: IP6103
#  3: APW7704F
TFA_PMIC = "0"
# =========================================================================
# secure boot
# =========================================================================
# "yes" boot from secure mode
# "no" boot from normal mode
SECURE_BOOT ="no"

# The NuWriter will encrypt all relative files by AES, 
# and calculate the ECDSA signature
AES_KEY = "0A0BC81E5AFBF836C5E0CFBEA12C1E269A2EBC3B0B6EC39EEE1C7142F760EBC4"
ECDSA_KEY = "8F1571E9975006A545DF854264F7B18934B5CB2EE619E66DBC0FBEA52C71C919"

# =========================================================================
# optee-os
# =========================================================================
# Whether Pack image contian OPTEE
#MACHINE_FEATURES_append = " optee "
OPTEE_SRCREV = "master"

# =========================================================================
# fs
# =========================================================================
# The system default is sdhci1 to boot, if you want to use sdhci0 to boot,
# you need to set UBOOT_CONFIG[sdcard] = "ma35d1_sdcard1_defconfig" 
IMAGE_FSTYPES = " sdcard ext4 tar.bz2 ubi spinand nand"

# =========================================================================
# libjpeg-turbo
# =========================================================================
JPEG_HW_DEC = "yes"

# =========================================================================
# Auto Expand SD Max Size
# =========================================================================
# Change "/dev/mmcblk0" or "p1" as below to match the one use by 
# the SD card in ma35d1 board.
# Need to add CORE_IMAGE_EXTRA_INSTALL += " sd-maxsize" in conf/local.conf to enable.
DISK_DRIVE = "/dev/mmcblk0"
DISK_NUM = "p1"
```

## meta-ma35d1/conf/machine/numaker-iot-ma35d16f70.conf
```bitbake
#@TYPE: Machine
#@NAME: ma35d1-evb
#@DESCRIPTION: Configuration for all ma35d1 boards (EV, DK, ...)
#@NEEDED_BSPLAYERS: layers/meta-openembedded/meta-oe layers/meta-openembedded/meta-python

MACHINEOVERRIDES = "ma35d1:ma35d1iot"

require conf/machine/include/ma35d1-base.inc
# =========================================================================
# Kernel
# =========================================================================
KERNEL_SRCREV = "master"
KERNEL_DEFCONFIG = "ma35d1_defconfig"

# Set DDR Size according to the board.
# The currently provideed device tree are as follows:
# 	- nuvoton/ma35d1-iot-128m.dtb
# 	- nuvoton/ma35d1-iot-512m.dtb
KERNEL_DEVICETREE = "nuvoton/ma35d1-iot-128m.dtb"

# =========================================================================
# u-boot
# =========================================================================
UBOOT_SRCREV = "master"
UBOOT_CONFIG ??= "sdcard spinand nand"
UBOOT_CONFIG[nand] = "ma35d1_nand_defconfig"
UBOOT_CONFIG[spinand] = "ma35d1_spinand_defconfig"
UBOOT_CONFIG[sdcard] = "ma35d1_sdcard1_defconfig"

# =========================================================================
# trusted-firmware-a
# =========================================================================
TFA_SRCREV = "master"

# Set CPU speed, DDR type according to the board. 
# The currently provideed device tree are as follows:
#	- ma35d1-cpu800-wb-128m
#	- ma35d1-cpu800-wb-512m
TFA_DTB = "ma35d1-cpu800-wb-128m"

# =========================================================================
# optee-os
# =========================================================================
# Whether Pack image contian OPTEE
#MACHINE_FEATURES_append = " optee "
OPTEE_SRCREV = "master"

# =========================================================================
# fs
# =========================================================================
# The system default is sdhci1 to boot, if you want to use sdhci0 to boot,
# you need to set UBOOT_CONFIG[sdcard] = "ma35d1_sdcard1_defconfig" 
IMAGE_FSTYPES = " sdcard ext4 tar.bz2 ubi spinand nand"
```

## meta-ma35d1/conf/machine/numaker-iot-ma35d16f90.conf
```bitbake
#@TYPE: Machine
#@NAME: ma35d1-evb
#@DESCRIPTION: Configuration for all ma35d1 boards (EV, DK, ...)
#@NEEDED_BSPLAYERS: layers/meta-openembedded/meta-oe layers/meta-openembedded/meta-python

MACHINEOVERRIDES = "ma35d1:ma35d1iot"

require conf/machine/include/ma35d1-base.inc
# =========================================================================
# Kernel
# =========================================================================
KERNEL_SRCREV = "master"
KERNEL_DEFCONFIG = "ma35d1_defconfig"

# Set DDR Size according to the board.
# The currently provideed device tree are as follows:
# 	- nuvoton/ma35d1-iot-128m.dtb
# 	- nuvoton/ma35d1-iot-512m.dtb
KERNEL_DEVICETREE = "nuvoton/ma35d1-iot-512m.dtb"

# Set linux verison
# The currently provideed linux verison are as follows:
#       - 5.4.181
#       - 5.10.140
PREFERRED_VERSION_linux-ma35d1 = "5.10.140"
# =========================================================================
# u-boot
# =========================================================================
UBOOT_SRCREV = "master"
UBOOT_CONFIG ??= "sdcard spinand nand spinor"
UBOOT_CONFIG[nand] = "ma35d1_nand_defconfig"
UBOOT_CONFIG[spinand] = "ma35d1_spinand_defconfig"
UBOOT_CONFIG[sdcard] = "ma35d1_sdcard1_defconfig"
UBOOT_CONFIG[spinor] = "ma35d1_spinor_defconfig"

UBOOT_SPINOR_BOOTARGS= "root=/dev/mmcblk1p1 rootfstype=ext4"

# =========================================================================
# trusted-firmware-a
# =========================================================================
TFA_SRCREV = "master"

# Set CPU speed, DDR type according to the board. 
# The currently provideed device tree are as follows:
#	- ma35d1-cpu800-wb-128m
#	- ma35d1-cpu800-wb-512m
#	- ma35d1-cpu800-custom-ddr
TFA_DTB = "ma35d1-cpu800-wb-512m"

# Update custom DDR parameters when TFA_DTB=ma35d1-cpu800-custom-ddr
TFA_DDR_HEADER = "custom_ddr.h"

# Set DDR_SIZE, it is vaild when TFA_DTB=ma35d1-cpu800-custom-ddr
TFA_DDR_SIZE = "0x20000000"

# Load RTP-M4 into FIP image and run RTP-M4
TFA_LOAD_M4 = "no"

# Need to set binary file from deploy/images/{machine}
TFA_M4_BIN= "m4proj/Template.bin"

# Set PMIC model
#  0: No PMIC
#  1: Dialog
#  2: IP6103
#  3: APW7704F
TFA_PMIC = "0"
# =========================================================================
# secure boot
# =========================================================================
# "yes" boot from secure mode
# "no" boot from normal mode
SECURE_BOOT ="no"

# The NuWriter will encrypt all relative files by AES, 
# and calculate the ECDSA signature
AES_KEY = "0A0BC81E5AFBF836C5E0CFBEA12C1E269A2EBC3B0B6EC39EEE1C7142F760EBC4"
ECDSA_KEY = "8F1571E9975006A545DF854264F7B18934B5CB2EE619E66DBC0FBEA52C71C919"

# =========================================================================
# optee-os
# =========================================================================
# Whether Pack image contian OPTEE
#MACHINE_FEATURES_append = " optee "
OPTEE_SRCREV = "master"

# =========================================================================
# fs
# =========================================================================
# The system default is sdhci1 to boot, if you want to use sdhci0 to boot,
# you need to set UBOOT_CONFIG[sdcard] = "ma35d1_sdcard1_defconfig" 
IMAGE_FSTYPES = " sdcard ext4 tar.bz2 ubi spinand nand"

# =========================================================================
# libjpeg-turbo
# =========================================================================
JPEG_HW_DEC = "yes"

# =========================================================================
# Auto Expand SD Max Size
# =========================================================================
# Change "/dev/mmcblk0" or "p1" as below to match the one use by 
# the SD card in ma35d1 board.
# Need to add CORE_IMAGE_EXTRA_INSTALL += " sd-maxsize" in conf/local.conf to enable.
DISK_DRIVE = "/dev/mmcblk0"
DISK_NUM = "p1"
```

## meta-ma35d1/conf/machine/numaker-som-ma35d16a81.conf
```bitbake
#@TYPE: Machine
#@NAME: ma35d1-evb
#@DESCRIPTION: Configuration for all ma35d1 boards (EV, DK, ...)
#@NEEDED_BSPLAYERS: layers/meta-openembedded/meta-oe layers/meta-openembedded/meta-python

MACHINEOVERRIDES = "ma35d1:ma35d1som"

require conf/machine/include/ma35d1-base.inc
# =========================================================================
# Kernel
# =========================================================================
KERNEL_SRCREV = "master"
KERNEL_DEFCONFIG = "ma35d1_defconfig"

# Set DDR Size according to the board.
# The currently provideed device tree are as follows:
#       - nuvoton/ma35d1-som-256m.dtb
#       - nuvoton/ma35d1-som-512m.dtb
KERNEL_DEVICETREE = "nuvoton/ma35d1-som-512m.dtb"

# =========================================================================
# u-boot
# =========================================================================
UBOOT_SRCREV = "master"
UBOOT_CONFIG ??= "sdcard nand spinand"
UBOOT_CONFIG[nand] = "ma35d1_nand_defconfig"
UBOOT_CONFIG[spinand] = "ma35d1_spinand_defconfig"
UBOOT_CONFIG[sdcard] = "ma35d1_sdcard0_defconfig"

# =========================================================================
# trusted-firmware-a
# =========================================================================
TFA_SRCREV = "master"

# Set CPU speed and DDR type according to the board.
# The currently provideed device tree are as follows:
#       - ma35d1-cpu1g-wb-256m
#       - ma35d1-cpu1g-wb-512m
#
#       - ma35d1-cpu1g-issi-1gb
#       - ma35d1-cpu1g-mc-1gb
#       - ma35d1-cpu1g-zt-1gb
#
#       - ma35d1-cpu800-wb-256m
#       - ma35d1-cpu800-wb-512m
#
#       - ma35d1-cpu800-issi-1gb
#       - ma35d1-cpu800-mc-1gb
#       - ma35d1-cpu800-zt-1gb
TFA_DTB = "ma35d1-cpu800-wb-512m"

# =========================================================================
# optee-os
# =========================================================================
# Whether Pack image contian OPTEE
# MACHINE_FEATURES_append = " optee "
OPTEE_SRCREV = "master"

# =========================================================================
# fs
# =========================================================================
IMAGE_FSTYPES = " sdcard ext4 tar.bz2 ubi spinand nand"
```
