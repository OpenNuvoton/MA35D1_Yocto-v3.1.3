## meta-ma35d0/conf/distro/nvt-ma35d0-directfb.conf
```bitbake
# Nuvoton DISTRO for the FrameBuffer graphical backend.

include conf/distro/include/nvt-base.inc

DISTRO = "nvt-ma35d0-directfb"

# Remove conflicting backends.
DISTRO_FEATURES_append += " "
```

## meta-ma35d0/conf/machine/numaker-iot-ma35d06f80.conf
```bitbake
#@TYPE: Machine
#@NAME: ma35d0-iot
#@DESCRIPTION: Configuration for all ma35d0 boards (EV, DK, ...)
#@NEEDED_BSPLAYERS: layers/meta-openembedded/meta-oe layers/meta-openembedded/meta-python

MACHINEOVERRIDES = "ma35d0:ma35d0iot"

require conf/machine/include/ma35d0-base.inc
# =========================================================================
# Kernel
# =========================================================================
KERNEL_SRCREV = "master"
KERNEL_DEFCONFIG = "ma35d0_defconfig"

# Set DDR Size according to the board.
# The currently provideed device tree are as follows:
# 	- nuvoton/ma35d0-iot-256m.dtb
KERNEL_DEVICETREE = "nuvoton/ma35d0-iot-256m.dtb"

# Set linux verison
# The currently provideed linux verison are as follows:
#       - 5.10.140
PREFERRED_VERSION_linux-ma35d0 = "5.10.140"
# =========================================================================
# u-boot
# =========================================================================
UBOOT_SRCREV = "master"
UBOOT_CONFIG ??= "sdcard spinand nand spinor"
UBOOT_CONFIG[nand] = "ma35d0_nand_defconfig"
UBOOT_CONFIG[spinand] = "ma35d0_spinand_defconfig"
UBOOT_CONFIG[sdcard] = "ma35d0_sdcard0_defconfig"
UBOOT_CONFIG[spinor] = "ma35d0_spinor_defconfig"

UBOOT_SPINOR_BOOTARGS= "root=/dev/mmcblk1p1 rootfstype=ext4"

# =========================================================================
# trusted-firmware-a
# =========================================================================
TFA_SRCREV = "master"

# Set CPU speed, DDR type according to the board. 
# The currently provideed device tree are as follows:
TFA_DTB = "ma35d0-cpu650-custom-ddr"

# Update custom DDR parameters
TFA_DDR_HEADER = "MA35D03F867C_MCP_WBDDR3L_256M_1PCS.h"

# Set DDR_SIZE
TFA_DDR_SIZE = "0x10000000"

# Set PMIC model
TFA_PMIC = "0"
# =========================================================================
# secure boot
# =========================================================================
# "yes" boot from secure mode
# "no" boot from normal mode
SECURE_BOOT ="no"

# The NuWriter will encrypt all relative files by AES, 
# and calculate the ECDSA signature
AES_KEY = "0A0BC81E5AFBF836C5E0CFBEA12C1E269A2EBC3B0B6EC39EEE1C7142F760EBC4"
ECDSA_KEY = "8F1571E9975006A545DF854264F7B18934B5CB2EE619E66DBC0FBEA52C71C919"

# =========================================================================
# optee-os
# =========================================================================
# Whether Pack image contian OPTEE
#MACHINE_FEATURES_append = " optee "
OPTEE_SRCREV = "master"

# =========================================================================
# fs
# =========================================================================
# The system default is sdhci1 to boot, if you want to use sdhci0 to boot,
# you need to set UBOOT_CONFIG[sdcard] = "ma35d0_sdcard1_defconfig" 
IMAGE_FSTYPES = " sdcard ext4 tar.bz2 ubi spinand nand"

# =========================================================================
# libjpeg-turbo
# =========================================================================
JPEG_HW_DEC = "yes"

# =========================================================================
# Auto Expand SD Max Size
# =========================================================================
# Change "/dev/mmcblk0" or "p1" as below to match the one use by 
# the SD card in ma35d0 board.
# Need to add CORE_IMAGE_EXTRA_INSTALL += " sd-maxsize" in conf/local.conf to enable.
DISK_DRIVE = "/dev/mmcblk0"
DISK_NUM = "p1"
```

## meta-ma35d1/conf/distro/include/nvt-base.inc
```bitbake
# ma35d1 DISTRO for the FrameBuffer graphical backend.

DISTRO = "nvt-base"
DISTRO_NAME = "Nuvoton Release Distro"
DISTRO_VERSION = "5.5-dunfell"

DISTRO_CODENAME = "dunfell"
SDK_VENDOR = "-pokysdk"
SDK_VERSION := "${DISTRO_VERSION}"

MAINTAINER = "Nuvoton <www.nuvoton.com>"

TARGET_VENDOR = "-poky"

DISTRO = "nvt-ma35d1"


PREFERRED_PROVIDER_udev = "systemd"
PREFERRED_PROVIDER_udev-utils = "systemd"


# =========================================================================
# DISTRO features
# =========================================================================
DISTRO_FEATURES ?= " vc8000 gc520 directfb virtualization systemd alsa"

CORE_IMAGE_EXTRA_INSTALL += " ${@bb.utils.contains('KERNEL_DEFCONFIG', 'ma35d1_drm_defconfig', '', 'dcultrafb', d)} "

VIRTUAL-RUNTIME_init_manager = "systemd"
DISTRO_FEATURES_BACKFILL_CONSIDERED += "sysvinit"
```

## meta-ma35d1/conf/distro/nvt-ma35d1-directfb.conf
```bitbake
# Nuvoton DISTRO for the FrameBuffer graphical backend.

include conf/distro/include/nvt-base.inc

DISTRO = "nvt-ma35d1-directfb"

# Remove conflicting backends.
DISTRO_FEATURES_append += " "
```

## meta-ma35d1/conf/distro/nvt-md35d1.conf
```bitbake
# Nuvoton DISTRO for the FrameBuffer graphical backend.

include conf/distro/include/nvt-base.inc

DISTRO = "nvt-ma35d1"

# Remove conflicting backends.
DISTRO_FEATURES_remove = "  dcultrafb gc520 directfb virtualization "
```

## meta-ma35d1/conf/layer.conf
```bitbake
# We have a conf and classes directory, add to BBPATH
BBPATH .= ":${LAYERDIR}"

# We have a recipes-* directories, add to BBFILES
BBFILES += "${LAYERDIR}/recipes-*/*/*.bb \
            ${LAYERDIR}/recipes-*/*/*.bbappend"

BBFILE_COLLECTIONS += "ma35d1-layer"
BBFILE_PATTERN_ma35d1-layer := "^${LAYERDIR}/"
BBFILE_PRIORITY_ma35d1-layer = "8"

# This should only be incremented on significant changes that will
# cause compatibility issues with other layers
LAYERVERSION_ma35d1-layer = "1"
LAYERSERIES_COMPAT_ma35d1-layer = "dunfell"

# for optee-os-ma35d1 dependency
LAYERDEPENDS_ma35d1-layer = "core openembedded-layer meta-python"
LAYERDEPENDS_ma35d1-layer += " qt5-layer "

# docker 
#CORE_IMAGE_EXTRA_INSTALL = "libcgroup cgroup-lite docker net-tools ca-certificates ffmpeg gstreamer1.0 gstreamer1.0-plugins-base"

CORE_IMAGE_EXTRA_INSTALL += " ${@bb.utils.contains('DISTRO_FEATURES', 'alsa', 'alsa-utils', '', d)} "
CORE_IMAGE_EXTRA_INSTALL += " ${@bb.utils.contains('DISTRO_FEATURES', '8189es', 'wpa-supplicant', '', d)} "
CORE_IMAGE_EXTRA_INSTALL += " ${@bb.utils.contains('DISTRO_FEATURES', '8192es', 'wpa-supplicant', '', d)} "
CORE_IMAGE_EXTRA_INSTALL += " ${@bb.utils.contains('DISTRO_FEATURES', 'directfb', 'directfb', '', d)} "
CORE_IMAGE_EXTRA_INSTALL += " ${@bb.utils.contains('DISTRO_FEATURES', 'gc520', 'gc520', '', d)} "
CORE_IMAGE_EXTRA_INSTALL += " ${@bb.utils.contains('DISTRO_FEATURES', 'dcultrafb', 'dcultrafb', '', d)} "
CORE_IMAGE_EXTRA_INSTALL += " ${@bb.utils.contains('DISTRO_FEATURES', 'vc8000', 'vc8000', '', d)} "
CORE_IMAGE_EXTRA_INSTALL += " ${@bb.utils.contains('IMAGE_FSTYPES', 'sdcard', 'e2fsprogs-resize2fs e2fsprogs-mke2fs parted', '', d)} "
CORE_IMAGE_EXTRA_INSTALL += " ${@bb.utils.contains('IMAGE_FSTYPES', 'nand', 'mtd-utils-ubifs', '', d)} "
CORE_IMAGE_EXTRA_INSTALL += " ${@bb.utils.contains('IMAGE_FSTYPES', 'spinand', 'mtd-utils-ubifs', '', d)} "
CORE_IMAGE_EXTRA_INSTALL += " ${@bb.utils.contains('MACHINE_FEATURES', 'optee', 'optee-client optee-examples optee-test', '', d)} "
```

## meta-ma35d1/conf/machine/include/ma35d1-base.inc
```bitbake
#@TYPE: Machine
#@NAME: ma35d1
#@DESCRIPTION: Configuration for all ma35d1 boards (EV, DK, ...)
#@NEEDED_BSPLAYERS: layers/meta-openembedded/meta-oe layers/meta-openembedded/meta-python

MACHINEOVERRIDES = "ma35d1"

# =========================================================================
# Chip architecture
# =========================================================================
DEFAULTTUNE_ma35d1 = "cortexa35-crypto"
include conf/machine/include/tune-cortexa35.inc

# =========================================================================
# Kernel
# =========================================================================
PREFERRED_PROVIDER_kernel = "linux-ma35d1"
PREFERRED_PROVIDER_virtual/kernel = "linux-ma35d1"

# =========================================================================
# u-boot
# =========================================================================
PREFERRED_PROVIDER_u-boot = "u-boot-ma35d1"
PREFERRED_PROVIDER_virtual/bootloader = "u-boot-ma35d1"

EXTRA_IMAGEDEPENDS += "virtual/bootloader"

UBOOT_ENTRYPOINT_ma35d1 = "0x80E00000"
# =========================================================================
# trusted-firmware-a
# =========================================================================
TFA_PLATFORM ?= "ma35d1"
TFA_DTB ?= "ma35d1xx7"
PREFERRED_PROVIDER_virtual/trusted-firmware-a = "tf-a-ma35d1"
EXTRA_IMAGEDEPENDS += "virtual/trusted-firmware-a"

# =========================================================================
# optee-os
# =========================================================================
OPTEE_PLATFORM = "nuvoton"
OPTEE_PLATFORM_FLAVOR = "MA35D1"
PREFERRED_PROVIDER_virtual/optee-os = "optee-os-ma35d1"
EXTRA_IMAGEDEPENDS += "virtual/optee-os"

# =========================================================================
# m4proj
# =========================================================================
EXTRA_IMAGEDEPENDS += "m4proj"

# =========================================================================
# nuwriter
# =========================================================================
EXTRA_IMAGEDEPENDS += "python3-nuwriter-native"

# =========================================================================
# fs
# =========================================================================
IMAGE_FSTYPES ?= " sdcard ext4 tar.bz2"
IMAGE_CLASSES = "image_types_nvt"

# Block size for SPINAND, kb
SPINAND_BLKZ ?= "128"

# Block size for NAND, kb
NAND_BLKZ ?= "128"

# Disable the serial console due to auto-serial-console
SERIAL_CONSOLES = "115200;ttyS0"

# we do not want to have getty running on tty1 as we run
# auto-serial-console there
USE_VT = "0"

# Free size for SD card, kb
SDCARD_FREE_SIZE ?="0"

# SD auto-resizes to Max on first boot,
# A specific disk must be selected
DISK_DRIVE ?= "mmcblk0"
DISK_NUM ?= "p1"


# Use the expected value of the ubifs filesystem's volume name in the kernel
UBI_VOLNAME ?= "rootfs"
# The biggest NANDs on current modules are 100MB.
# This sums up to 2048 LEBs available for the ubifs (-c)
MKUBIFS_ARGS ?= "-F -m 2048 -e 126976 -c 2800"
UBINIZE_ARGS ?= "-m 2048 -p 128KiB -s 2048 -O 2048"
```

## meta-ma35d1/conf/machine/ma35d1-evb.conf
```bitbake
#@TYPE: Machine
#@NAME: ma35d1-evb
#@DESCRIPTION: Configuration for all ma35d1 boards (EV, DK, ...)
#@NEEDED_BSPLAYERS: layers/meta-openembedded/meta-oe layers/meta-openembedded/meta-python

MACHINEOVERRIDES = "ma35d1:ma35d1evb"

require conf/machine/include/ma35d1-base.inc
# =========================================================================
# Kernel
# =========================================================================
KERNEL_DEFCONFIG = "ma35d1_defconfig"
KERNEL_DEVICETREE = "nuvoton/ma35d1-evb.dtb"

# =========================================================================
# u-boot
# =========================================================================
UBOOT_CONFIG ??= "sdcard nand spinand"
UBOOT_CONFIG[nand] = "ma35d1_nand_defconfig"
UBOOT_CONFIG[spinand] = "ma35d1_spinand_defconfig"
UBOOT_CONFIG[sdcard] = "ma35d1_sdcard1_defconfig"

# =========================================================================
# trusted-firmware-a
# =========================================================================
TFA_DTB = "ma35d1xx8"

# =========================================================================
# optee-os
# =========================================================================
# Whether Pack image contian OPTEE
# MACHINE_FEATURES_append = " optee "

# =========================================================================
# fs
# =========================================================================
IMAGE_FSTYPES = " sdcard ext4 tar.bz2 ubi spinand nand"
```

## meta-ma35d1/conf/machine/ma35d1-iot.conf
```bitbake
#@TYPE: Machine
#@NAME: ma35d1-evb
#@DESCRIPTION: Configuration for all ma35d1 boards (EV, DK, ...)
#@NEEDED_BSPLAYERS: layers/meta-openembedded/meta-oe layers/meta-openembedded/meta-python

MACHINEOVERRIDES = "ma35d1:ma35d1iot"

require conf/machine/include/ma35d1-base.inc
# =========================================================================
# Kernel
# =========================================================================
KERNEL_SRCREV = "master"
KERNEL_DEFCONFIG = "ma35d1_defconfig"
KERNEL_DEVICETREE = "nuvoton/ma35d1-iot.dtb"

# =========================================================================
# u-boot
# =========================================================================
UBOOT_SRCREV = "master"
UBOOT_CONFIG ??= "sdcard spinand nand"
UBOOT_CONFIG[nand] = "ma35d1_nand_defconfig"
UBOOT_CONFIG[spinand] = "ma35d1_spinand_defconfig"
UBOOT_CONFIG[sdcard] = "ma35d1_sdcard1_defconfig"

# =========================================================================
# trusted-firmware-a
# =========================================================================
TFA_SRCREV = "master"
TFA_DTB = "ma35d1xx7"

# =========================================================================
# optee-os
# =========================================================================
# Whether Pack image contian OPTEE
#MACHINE_FEATURES_append = " optee "
OPTEE_SRCREV = "master"

# =========================================================================
# fs
# =========================================================================
# The system default is sdhci1 to boot, if you want to use sdhci0 to boot,
# you need to set UBOOT_CONFIG[sdcard] = "ma35d1_sdcard1_defconfig" 
IMAGE_FSTYPES = " sdcard ext4 tar.bz2 ubi spinand nand"
```
